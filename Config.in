## configs/kbrd_defconfig
```kconfig
BR2_aarch64=y
BR2_cortex_a72=y
BR2_ARM_FPU_VFPV4=y
BR2_KERNEL_HEADERS_6_6=y
BR2_GLOBAL_PATCH_DIR="$(BR2_EXTERNAL)/board/kbrd/patches"
BR2_TARGET_GENERIC_HOSTNAME="KBRD OS"
BR2_TARGET_GENERIC_ISSUE="Welcome to KBRD OS"
BR2_TARGET_GENERIC_ROOT_PASSWD="DFKLK\"'(lkmlkm\"l'(poiglk,l\"'k'55"
BR2_SYSTEM_DHCP="eth0"
BR2_ROOTFS_USERS_TABLES="$(BR2_EXTERNAL)/board/kbrd/users.table"
BR2_ROOTFS_OVERLAY="$(BR2_EXTERNAL)/board/kbrd/rootfs-overlay"
BR2_ROOTFS_POST_BUILD_SCRIPT="$(BR2_EXTERNAL)/board/kbrd/post-build.sh"
BR2_ROOTFS_POST_FAKEROOT_SCRIPT="$(BR2_EXTERNAL)/board/kbrd/post-fakeroot.sh"
BR2_ROOTFS_POST_IMAGE_SCRIPT="$(BR2_EXTERNAL)/board/kbrd/post-image.sh"
BR2_LINUX_KERNEL=y
BR2_LINUX_KERNEL_CUSTOM_GIT=y
BR2_LINUX_KERNEL_CUSTOM_REPO_URL="https://github.com/raspberrypi/linux.git"
BR2_LINUX_KERNEL_CUSTOM_REPO_VERSION="rpi-6.6.y"
BR2_LINUX_KERNEL_USE_CUSTOM_CONFIG=y
BR2_LINUX_KERNEL_CUSTOM_CONFIG_FILE="$(BR2_EXTERNAL)/board/kbrd/linux_defconfig"
BR2_LINUX_KERNEL_DTS_SUPPORT=y
BR2_LINUX_KERNEL_INTREE_DTS_NAME="broadcom/bcm2711-rpi-4-b broadcom/bcm2711-rpi-400 broadcom/bcm2711-rpi-cm4 broadcom/bcm2711-rpi-cm4s"
BR2_LINUX_KERNEL_NEEDS_HOST_OPENSSL=y
BR2_PACKAGE_BUSYBOX_CONFIG="$(BR2_EXTERNAL)/package/busybox/busybox.config"
BR2_PACKAGE_BUSYBOX_SHOW_OTHERS=y
BR2_PACKAGE_GSTREAMER1=y
BR2_PACKAGE_GST1_PLUGINS_BASE=y
BR2_PACKAGE_GST1_PLUGINS_BASE_PLUGIN_APP=y
BR2_PACKAGE_XZ=y
BR2_PACKAGE_STRACE=y
BR2_PACKAGE_FBV=y
# BR2_PACKAGE_FBV_JPEG is not set
BR2_PACKAGE_SDL2=y
BR2_PACKAGE_SDL2_TTF=y
BR2_PACKAGE_BRCMFMAC_SDIO_FIRMWARE_RPI=y
BR2_PACKAGE_BRCMFMAC_SDIO_FIRMWARE_RPI_WIFI=y
BR2_PACKAGE_RPI_FIRMWARE=y
BR2_PACKAGE_RPI_FIRMWARE_VARIANT_PI4=y
BR2_PACKAGE_RPI_FIRMWARE_CONFIG_FILE="$(BR2_EXTERNAL)/board/kbrd/config.txt"
BR2_PACKAGE_I2C_TOOLS=y
BR2_PACKAGE_KBD=y
BR2_PACKAGE_RASPI_GPIO=y
BR2_PACKAGE_PYTHON3=y
BR2_PACKAGE_PYTHON3_PY_ONLY=y
BR2_PACKAGE_PYTHON3_SQLITE=y
BR2_PACKAGE_PYTHON_REQUESTS=y
BR2_PACKAGE_PYTHON_SETUPTOOLS=y
BR2_PACKAGE_LIBDRM=y
BR2_PACKAGE_LIBDRM_VC4=y
BR2_PACKAGE_LIBDRM_INSTALL_TESTS=y
BR2_PACKAGE_LIBGPIOD=y
BR2_PACKAGE_LIBGPIOD_TOOLS=y
BR2_PACKAGE_IW=y
BR2_PACKAGE_IWD=y
BR2_PACKAGE_NGINX=y
BR2_PACKAGE_OPENSSH=y
# BR2_PACKAGE_OPENSSH_CLIENT is not set
BR2_PACKAGE_WIRELESS_REGDB=y
BR2_PACKAGE_BASH=y
BR2_PACKAGE_SUDO=y
BR2_PACKAGE_HTOP=y
BR2_PACKAGE_KMOD=y
BR2_PACKAGE_KMOD_TOOLS=y
BR2_PACKAGE_NANO=y
BR2_TARGET_ROOTFS_EXT2=y
BR2_TARGET_ROOTFS_EXT2_4=y
BR2_TARGET_ROOTFS_EXT2_SIZE="200M"
# BR2_TARGET_ROOTFS_TAR is not set
BR2_PACKAGE_HOST_DOSFSTOOLS=y
BR2_PACKAGE_HOST_GENIMAGE=y
BR2_PACKAGE_HOST_KMOD_XZ=y
BR2_PACKAGE_HOST_MTOOLS=y
BR2_PACKAGE_KBRD_UI=y
BR2_PACKAGE_KBRD_DEV=y
```

## package/Config.in
```kconfig
source "$BR2_EXTERNAL_KBRD_OS_PATH/package/kbrd-web/Config.in"
source "$BR2_EXTERNAL_KBRD_OS_PATH/package/kbrd-api/Config.in"
source "$BR2_EXTERNAL_KBRD_OS_PATH/package/kbrd-dev/Config.in"
source "$BR2_EXTERNAL_KBRD_OS_PATH/package/python-kivy/Config.in"
source "$BR2_EXTERNAL_KBRD_OS_PATH/package/python-filetype/Config.in"
```

## package/kbrd-api/Config.in
```kconfig
config BR2_PACKAGE_KBRD_API
	bool "kbrd-api"
	depends on BR2_PACKAGE_PYTHON3
	select BR2_PACKAGE_PYTHON_FLASK
	help
	  KBRD API
```

## package/kbrd-dev/Config.in
```kconfig
config BR2_PACKAGE_KBRD_DEV
	bool "kbrd-dev"
	depends on BR2_PACKAGE_PYTHON3

	select BR2_PACKAGE_PYTHON_KIVY
	select BR2_PACKAGE_PYTHON_PILLOW

	help
	  KBRD graphical user interface.
```

## package/kbrd-ui/Config.in
```kconfig
config BR2_PACKAGE_KBRD_UI
	bool "kbrd-ui"
    select BR2_PACKAGE_KBRD_API
	help
	  KBRD UI
```

## package/kbrd-web/Config.in
```kconfig
config BR2_PACKAGE_KBRD_WEB
	bool "kbrd-web"
    select BR2_PACKAGE_KBRD_API
	help
	  KBRD WEB
```

## package/noto-color-emoji/Config.in
```kconfig
config BR2_PACKAGE_NOTO_COLOR_EMOJI
	bool "noto-color-emoji"
	help
	  Noto Color Emoji font with CBDT/CBLC bitmap glyphs.

	  https://github.com/googlefonts/noto-emoji
```

## package/python-filetype/Config.in
```kconfig
config BR2_PACKAGE_PYTHON_FILETYPE
	bool "python-filetype"
	depends on BR2_PACKAGE_PYTHON3
	help
	  Small and dependency-free Python package to infer
	  file type and MIME type from file contents.

	  https://github.com/h2non/filetype.py
```

## package/python-kivy/Config.in
```kconfig
config BR2_PACKAGE_PYTHON_KIVY
	bool "python-kivy"
	depends on BR2_PACKAGE_PYTHON3
	depends on BR2_PACKAGE_HAS_LIBGLES
	depends on BR2_PACKAGE_HAS_LIBEGL

    select BR2_PACKAGE_PYTHON_FILETYPE
	select BR2_PACKAGE_SDL2
	select BR2_PACKAGE_SDL2_IMAGE
	select BR2_PACKAGE_SDL2_MIXER
	select BR2_PACKAGE_SDL2_TTF

	help
	  Kivy graphical user interface framework.

	  https://kivy.org/
```
